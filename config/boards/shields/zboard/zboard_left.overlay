// xiao_flex_v2_left.overlay

#include "xiao_flex_v2.dtsi" 

&kscan0 {
    col-gpios
        = <&gpio0 10 GPIO_ACTIVE_HIGH> 
        , <&gpio1 11 GPIO_ACTIVE_HIGH>
        , <&gpio1 13 GPIO_ACTIVE_HIGH>
        , <&gpio1 15 GPIO_ACTIVE_HIGH> 
        , <&gpio0 2 GPIO_ACTIVE_HIGH> 
        , <&gpio0 29 GPIO_ACTIVE_HIGH> 
        ;
};