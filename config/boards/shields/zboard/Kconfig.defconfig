## config/boards/shields/zboard/Kconfig.defconfig
```kconfig
if SHIELD_ZBOARD_RIGHT

config ZMK_KEYBOARD_NAME
    default "zBoard"

config ZMK_SPLIT_ROLE_CENTRAL
    default y

endif

if SHIELD_ZBOARD_LEFT || SHIELD_ZBOARD_RIGHT

config ZMK_SPLIT
    default y

endif
```

## config/boards/shields/zboard/Kconfig.shield
```kconfig
config SHIELD_ZBOARD
    bool

config SHIELD_ZBOARD_LEFT
    def_bool $(shields_list_contains,zboard_left)
    select SHIELD_ZBOARD

config SHIELD_ZBOARD_RIGHT
    def_bool $(shields_list_contains,zboard_right)
    select SHIELD_ZBOARD
```
